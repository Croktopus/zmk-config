## config/boards/arm/max/Kconfig.board
```kconfig
# Copyright (c) 2020 The ZMK Contributors
# SPDX-License-Identifier: MIT

config BOARD_MAX
        bool "max"
        select ZMK_STUDIO
        select ZMK_STUDIO_TRANSPORT_UART
        depends on SOC_NRF52840_QIAA
```

## config/boards/arm/sinath/Kconfig.board
```kconfig
# Copyright (c) 2020 The ZMK Contributors
# SPDX-License-Identifier: MIT

config BOARD_SINATH
	bool "sinath"
	depends on SOC_NRF52840_QIAA
```

## config/boards/arm/tahoe/Kconfig.board
```kconfig
# Copyright (c) 2020 The ZMK Contributors
# SPDX-License-Identifier: MIT

config BOARD_TAHOE
        bool "tahoe"
        #select ZMK_STUDIO
        #select ZMK_STUDIO_TRANSPORT_UART
        depends on SOC_NRF52840_QIAA
```

## config/boards/arm/tahoe_a/Kconfig.board
```kconfig
# Copyright (c) 2020 The ZMK Contributors
# SPDX-License-Identifier: MIT

config BOARD_TAHOE_A
	bool "tahoe rev A"
	depends on SOC_NRF52840_QIAA
```

## config/west.yml
```yaml
manifest:
  remotes:
    - name: zmkfirmware
      url-base: https://github.com/zmkfirmware
    - name: croktopus
      url-base: https://github.com/croktopus
  projects:
    - name: zmk
      remote: zmkfirmware
      revision: main
      import: app/west.yml
  self:
    path: config
```
